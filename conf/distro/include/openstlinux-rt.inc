## conf/distro/include/openstlinux-rt.inc
```bitbake
# Distribution definition for stm32mp

# from dev manual:
# Your configuration file needs to set the following variables:
#
#      DISTRO_NAME [required]
#      DISTRO_VERSION [required]
#      DISTRO_FEATURES [required if creating from scratch]
#      DISTRO_EXTRA_RDEPENDS [optional]
#      DISTRO_EXTRA_RRECOMMENDS [optional]
#      TCLIBC [required if creating from scratch]

LOCALCONF_VERSION = "2"
LAYER_CONF_VERSION ?= "7"

# Set common distrooverrides for RT distro
DISTROOVERRIDES =. "openstlinuxcommonrt:"

# =========================================================================
# Set default distro naming
# =========================================================================
require conf/distro/include/openstlinux-default-naming.inc

# =========================================================================
# Enable uninative support
# =========================================================================
require conf/distro/include/no-static-libs.inc
require conf/distro/include/yocto-uninative.inc
INHERIT += "uninative"

# =========================================================================
# DISTRO features
# =========================================================================
DISTRO_FEATURES  = ""
DISTRO_FEATURES += "argp"
DISTRO_FEATURES += "ext2"
DISTRO_FEATURES += "ext4"
DISTRO_FEATURES += "largefile"
DISTRO_FEATURES += "ipv4"
DISTRO_FEATURES += "multiarch"
DISTRO_FEATURES += "xattr"


# add support of optee
DISTRO_FEATURES:append = " optee "

# add support of autoresize through InitRD
DISTRO_FEATURES:append = " autoresize "
DISTRO_FEATURES:append = " initrd "

# Disabling pulseaudio
DISTRO_FEATURES_BACKFILL_CONSIDERED += "pulseaudio"

# =========================================================================
# IMAGE addons
# =========================================================================
# TODO: is that really want we want?
IMAGE_LINGUAS = "en-gb"

# Packages to add to image being built

# Add locale command
IMAGE_INSTALL:append = " glibc-utils localedef "
```

## conf/distro/openstlinux-rt.conf
```bitbake
#@NAME: openstlinux-rt
#@DESCRIPTION: OpenSTLinux featuring RT

# =========================================================================
# DISTRO RT configuration
# =========================================================================
require include/openstlinux-rt.inc
require conf/distro/include/st-default-distro-rules.inc

# =========================================================================
# Distribution definition for: openstlinux-rt
# =========================================================================
DISTRO = "openstlinux-rt"
DISTRO_NAME = "OpenSTLinux distribution for RT feature - (A Yocto Project Based Distro)"

# Warning: TARGET_VENDOR does not contains a valid OS/ARCH name like : linux, arm
# Warning: '-' are forbidden between each word of TARGET_VENDOR
STM32MP_TARGETVENDOR = "-openstlinuxrt"

# Warning: '-' are forbidden between each word of SDK_VENDOR
SDK_VENDOR = "-openstlinuxrt_sdk"
```

## conf/machine/stm32mp1-rt.conf
```bitbake
#@TYPE: Machine
#@NAME: stm32mp1-rt
#@DESCRIPTION: Configuration for STM32MP1 RT boards (EV, DK, ...)
#@NEEDED_BSPLAYERS: layers/meta-openembedded/meta-oe layers/meta-openembedded/meta-python layers/meta-st/meta-st-stm32mp

# Define specific familly common machine name
MACHINEOVERRIDES =. "stm32mp1rt:"
MACHINEOVERRIDES =. "stm32mprtcommon:"
MACHINEOVERRIDES =. "stm32mp1:"

EXTERNAL_DT_ENABLED = "1"

require conf/machine/stm32mp1.conf

# =========================================================================
# OPTEE profile
# =========================================================================
ST_OPTEE_PROFILE = "system_services"

# =========================================================================
# Reset variables
# =========================================================================
STM32MP_DT_FILES_EMMC   = ""
STM32MP_DT_FILES_SDCARD = ""
STM32MP_DT_FILES_NAND   = ""
STM32MP_DT_FILES_NOR    = ""

EXTERNAL_DEVICETREE_SDCARD = ""
EXTERNAL_DEVICETREE_EMMC   = ""
EXTERNAL_DEVICETREE_NOR    = ""
EXTERNAL_DEVICETREE_NAND   = ""

# =========================================================================
# Machine settings
# =========================================================================
# Define list of devicetree per board
EXTERNAL_DEVICETREE_SDCARD =+ "stm32mp157f-dk2-rt stm32mp157f-ev1-rt"
EXTERNAL_DEVICETREE_SDCARD =+ "stm32mp135f-dk-rt"

# =========================================================================
# Machine features
# =========================================================================
# add RT support
MACHINE_FEATURES += "rt"
```

## conf/machine/stm32mp13-rt.conf
```bitbake
#@TYPE: Machine
#@NAME: stm32mp13-rt
#@DESCRIPTION: Configuration for STM32MP13 RT boards (DK)
#@NEEDED_BSPLAYERS: layers/meta-openembedded/meta-oe layers/meta-openembedded/meta-python layers/meta-st/meta-st-stm32mp

EXTERNAL_DT_ENABLED = "1"

# Define specific familly common machine name
MACHINEOVERRIDES =. "stm32mp1rt:"
MACHINEOVERRIDES =. "stm32mprtcommon:"
MACHINEOVERRIDES .= ":stm32mp13-disco"

require conf/machine/stm32mp13-disco.conf

# =========================================================================
# OPTEE profile
# =========================================================================
ST_OPTEE_PROFILE = "system_services"

# =========================================================================
# Reset variables
# =========================================================================
STM32MP_DT_FILES_EMMC   = ""
STM32MP_DT_FILES_SDCARD = ""
STM32MP_DT_FILES_NAND   = ""
STM32MP_DT_FILES_NOR    = ""

EXTERNAL_DEVICETREE_SDCARD = ""
EXTERNAL_DEVICETREE_EMMC   = ""
EXTERNAL_DEVICETREE_NOR    = ""
EXTERNAL_DEVICETREE_NAND   = ""

# =========================================================================
# Machine settings
# =========================================================================
# Define list of devicetree per board
EXTERNAL_DEVICETREE_SDCARD =+ "stm32mp135f-dk-rt"

# =========================================================================
# Machine features
# =========================================================================
# add RT support
MACHINE_FEATURES += "rt"
```

## conf/machine/stm32mp15-rt.conf
```bitbake
#@TYPE: Machine
#@NAME: stm32mp15-rt
#@DESCRIPTION: Configuration for STM32MP15 RT boards (EV, DK, ...)
#@NEEDED_BSPLAYERS: layers/meta-openembedded/meta-oe layers/meta-openembedded/meta-python layers/meta-st/meta-st-stm32mp

require conf/machine/stm32mp1.conf

# Define specific familly common machine name
MACHINEOVERRIDES .= ":stm32mp1"
MACHINEOVERRIDES .= ":stm32mp1rt"

# =========================================================================
# boot scheme
# =========================================================================
BOOTSCHEME_LABELS = "optee"

# =========================================================================
# Machine settings
# =========================================================================
# Define list of devicetree per board
STM32MP_DT_FILES_DK = "stm32mp157d-dk1"
STM32MP_DT_FILES_DK += "stm32mp157c-dk2 stm32mp157f-dk2"
STM32MP_DT_FILES_EV = "stm32mp157c-ev1 stm32mp157d-ev1 stm32mp157f-ev1"

# =========================================================================
# Machine features
# =========================================================================
# add RT support
MACHINE_FEATURES += "rt"
```
