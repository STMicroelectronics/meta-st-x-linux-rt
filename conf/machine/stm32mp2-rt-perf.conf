## conf/machine/stm32mp2-rt-perf.conf
```bitbake
#@TYPE: Machine
#@NAME: stm32mp2
#@DESCRIPTION: Configuration for all STM32MP2 RT boards (EV, DK, ...)
#@NEEDED_BSPLAYERS: layers/meta-openembedded/meta-oe layers/meta-openembedded/meta-python layers/meta-st/meta-st-stm32mp

# Define specific familly common machine name
MACHINEOVERRIDES =. "stm32mp2rt:"
MACHINEOVERRIDES =. "stm32mprtcommon:"
MACHINEOVERRIDES =. "stm32mp2:"

EXTERNAL_DT_ENABLED = "1"

require conf/machine/stm32mp2.conf

# =========================================================================
# BOOTSCHEME
# =========================================================================
BOOTSCHEME_LABELS = "opteemin"
BOOTSCHEME_LABELS += "fastboot-opteemin"

# =========================================================================
# Reset variables
# =========================================================================
STM32MP_DT_FILES_EMMC    = ""
STM32MP_DT_FILES_SDCARD  = ""
STM32MP_DT_FILES_NOR     = ""

EXTERNAL_DEVICETREE_SDCARD = ""
EXTERNAL_DEVICETREE_EMMC   = ""
EXTERNAL_DEVICETREE_NOR    = ""

# =========================================================================
# Machine settings
# =========================================================================
# Define list of devicetree per board
EXTERNAL_DEVICETREE_EMMC   =+ "stm32mp257f-ev1-perf-rt"
EXTERNAL_DEVICETREE_SDCARD =+ "stm32mp257f-ev1-perf-rt"
EXTERNAL_DEVICETREE_NOR    =+ "stm32mp257f-ev1-perf-rt"

EXTERNAL_DEVICETREE_EMMC   =+ "stm32mp257f-dk-perf-rt"
EXTERNAL_DEVICETREE_SDCARD =+ "stm32mp215f-dk-perf-rt"
EXTERNAL_DEVICETREE_SDCARD =+ "stm32mp257f-dk-perf-rt"

# =========================================================================
# Machine features
# =========================================================================
# add RT support
MACHINE_FEATURES += "rt"

# for kernel purpose, add specific kernel configuration
MACHINE_FEATURES =+ "rtperf"
```

## conf/machine/stm32mp2-rt.conf
```bitbake
#@TYPE: Machine
#@NAME: stm32mp2
#@DESCRIPTION: Configuration for all STM32MP2 RT boards (EV, DK, ...)
#@NEEDED_BSPLAYERS: layers/meta-openembedded/meta-oe layers/meta-openembedded/meta-python layers/meta-st/meta-st-stm32mp

# Define specific familly common machine name
MACHINEOVERRIDES =. "stm32mp2rt:"
MACHINEOVERRIDES =. "stm32mprtcommon:"
MACHINEOVERRIDES =. "stm32mp2:"

EXTERNAL_DT_ENABLED = "1"

require conf/machine/stm32mp2.conf

# =========================================================================
# BOOTSCHEME
# =========================================================================
BOOTSCHEME_LABELS = "opteemin"
BOOTSCHEME_LABELS += "fastboot-opteemin"

# =========================================================================
# Reset variables
# =========================================================================
STM32MP_DT_FILES_EMMC    = "stm32mp257f-ev1"
STM32MP_DT_FILES_SDCARD  = "stm32mp215f-dk "
STM32MP_DT_FILES_SDCARD += "stm32mp257f-dk stm32mp257f-ev1 "
STM32MP_DT_FILES_NOR     = "stm32mp257f-ev1"

EXTERNAL_DEVICETREE_SDCARD = ""
EXTERNAL_DEVICETREE_EMMC   = ""
EXTERNAL_DEVICETREE_NOR    = ""

# =========================================================================
# Machine settings
# =========================================================================
# Define list of devicetree per board
EXTERNAL_DEVICETREE_EMMC   = ""
EXTERNAL_DEVICETREE_SDCARD = ""
EXTERNAL_DEVICETREE_NOR    = ""

# =========================================================================
# Machine features
# =========================================================================
# add RT support
MACHINE_FEATURES += "rt"
```
